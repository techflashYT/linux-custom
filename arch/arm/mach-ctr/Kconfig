## arch/arm/mach-ctr/Kconfig
```kconfig
config ARCH_CTR
	bool "CTR (Nintendo 3DS family)"
	select ARM_GIC
	select ARM_AMBA
	select CPU_V6K
	select HAVE_SMP
	select HAVE_ARM_SCU
	select HAVE_ARM_TWD
	select GENERIC_IRQ_CHIP
	select GENERIC_CLOCKEVENTS
	select CLKDEV_LOOKUP
	select COMMON_CLK
	select GENERIC_CLOCKEVENTS
	select SOC_BUS
	select USE_OF
	help
	  Support for the Nintendo 3DS game console.
	  Runs on all (old3DS, new3DS, old2DS and new2DS)
	  & XL models.
```
